## packages/grate-firmware/defconfig
```kconfig
CONFIG_VENDOR_MORSHOW=y
CONFIG_BOARD_MORSHOW_MX_JB01=y
CONFIG_HAVE_IFD_BIN=y
CONFIG_IFD_BIN_PATH="@BLOBS@/ifd.bin"
CONFIG_HAVE_ME_BIN=y
CONFIG_ME_BIN_PATH="@BLOBS@/me.bin"
# CONFIG_FSP_USE_REPO is not set
CONFIG_ADD_FSP_BINARIES=y
CONFIG_FSP_M_FILE="@BLOBS@/fsp_m.bin"
CONFIG_FSP_S_FILE="@BLOBS@/fsp_s.bin"
CONFIG_INTEL_GMA_VBT_FILE="@BLOBS@/vbt.bin"
CONFIG_RUN_FSP_GOP=y
CONFIG_CPU_MICROCODE_CBFS_EXTERNAL_BINS=y
CONFIG_CPU_UCODE_BINARIES="@MICROCODE@"
CONFIG_CONSOLE_SPI_FLASH=y
CONFIG_SMMSTORE=y
CONFIG_PAYLOAD_EDK2=y
CONFIG_EDK2_UEFIPAYLOAD=y
CONFIG_EDK2_REPO_MRCHROMEBOX=y
CONFIG_EDK2_CBMEM_LOGGING=y
CONFIG_EDK2_ENABLE_IPXE=y
```
